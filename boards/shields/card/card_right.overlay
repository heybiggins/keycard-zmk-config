#include "card.dtsi"

&default_transform {
    col-offset = <5>;
};

&kscan0 {
    col-gpios
        = <&pro_micro 9 GPIO_ACTIVE_HIGH> // thumb
        , <&pro_micro 5 GPIO_ACTIVE_HIGH> // index
        , <&pro_micro 6 GPIO_ACTIVE_HIGH> // middle
        , <&pro_micro 7 GPIO_ACTIVE_HIGH> // ring
        , <&pro_micro 8 GPIO_ACTIVE_HIGH> // pinky
        ;
};
