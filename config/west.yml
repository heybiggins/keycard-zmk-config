## config/west.yml
```yaml
manifest:
  remotes:
    - name: heybiggins
      url-base: https://github.com/heybiggins
  projects:
    - name: zmk
      remote: heybiggins
      revision: main
      import: app/west.yml
  self:
    path: config
```
